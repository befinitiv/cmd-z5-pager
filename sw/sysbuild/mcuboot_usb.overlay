/* MCUboot: SMP on the USB CDC ACM port (the console stays on RTT). */
/ {
	chosen {
		zephyr,uart-mcumgr = &cdc_acm_uart0;
	};
};

/* The GPS stays unpowered in the bootloader; keep its UART lines idle. */
&uart0 {
	status = "disabled";
};

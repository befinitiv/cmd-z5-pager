## sw/boards/befi/cmdz5/board.yml
```yaml
board:
  name: cmdz5
  full_name: CMD-Z5 replacement board
  vendor: befi
  socs:
    - name: nrf52840
```

## sw/drivers/Kconfig
```kconfig
# Drivers for the CMD-Z5 hardware

config CMDZ5_LCD
	bool "CMD-Z5 display controller driver"
	default y
	depends on DT_HAS_SONY_CMDZ5_LCD_ENABLED

config CMDZ5_LCD_INIT_PRIORITY
	int "Display driver init priority"
	default 90
	help
	  Must be after the regulator that supplies the display.
	depends on CMDZ5_LCD

config CMDZ5_LCD_BUS_GPIO
	bool "Display bus bit-banged on GPIOs"
	default y
	depends on DT_HAS_CMDZ5_LCD_BUS_GPIO_ENABLED
	select GPIO

config CMDZ5_LCD_BUS_WR_LOW_NOPS
	int "Extra NOPs while /WR is low"
	default 16
	depends on CMDZ5_LCD_BUS_GPIO
	help
	  Stretches the /WR low phase. The original phone uses 300-350 ns.

config CMDZ5_LCD_BUS_INIT_PRIORITY
	int "Display bus init priority"
	default 80

module = CMDZ5_LCD
module-str = CMD-Z5 display
source "subsys/logging/Kconfig.template.log_config"

config CMDZ5_AUDIO_PWM
	bool "PCM output on an nRF PWM instance with EasyDMA"
	default y
	depends on DT_HAS_CMDZ5_AUDIO_PWM_ENABLED
	select NRFX_PWM
	select PINCTRL

config CMDZ5_AUDIO_INIT_PRIORITY
	int "Audio output init priority"
	default 90
	help
	  Must be after the regulator that supplies the earpiece amplifier.

module = CMDZ5_AUDIO
module-str = CMD-Z5 audio
source "subsys/logging/Kconfig.template.log_config"

config CMDZ5_SX1262
	bool "SX1262 mesh radio driver"
	default y
	depends on DT_HAS_CMDZ5_SX1262_ENABLED
	select SPI
	select GPIO
	select REGULATOR

config CMDZ5_SX1262_INIT_PRIORITY
	int "SX1262 driver init priority"
	default 90
	depends on CMDZ5_SX1262
	help
	  Must be after SPI, GPIO and the regulator that supplies the radio.

config CMDZ5_SX1262_THREAD_STACK_SIZE
	int "SX1262 interrupt thread stack size"
	default 2048
	depends on CMDZ5_SX1262

module = CMDZ5_RADIO
module-str = CMD-Z5 radio
source "subsys/logging/Kconfig.template.log_config"

config CMDZ5_GPS_M10
	bool "u-blox M10 GPS receiver with a switched supply"
	default y
	depends on DT_HAS_CMDZ5_GPS_M10_ENABLED
	depends on GNSS
	depends on GNSS_REFERENCE_FRAME_WGS84
	select GPIO
	select SERIAL
	select UART_INTERRUPT_DRIVEN
	select PM_DEVICE
	select MODEM_MODULES
	select MODEM_BACKEND_UART
	select MODEM_CHAT
	select GNSS_PARSE
	select GNSS_NMEA0183
	select GNSS_NMEA0183_MATCH

config CMDZ5_GPS_M10_SATELLITES_COUNT
	int "Maximum number of satellites reported"
	default 24
	depends on CMDZ5_GPS_M10 && GNSS_SATELLITES
```

## sw/dts/bindings/cmdz5,led-emul.yaml
```yaml
description: |
  Emulated LED-like outputs shown on the emulator front panel. Implements the
  Zephyr LED API; each child is one LED index.

compatible: "cmdz5,led-emul"

include: base.yaml

child-binding:
  description: One emulated output.
  properties:
    role:
      type: string
      required: true
      enum:
        - "backlight"
        - "vibration"
```

## sw/dts/bindings/cmdz5,radio-emul.yaml
```yaml
description: |
  Emulated LoRa radio for native_sim: UDP multicast between emulator
  instances, see emul/radio_emul.c.

compatible: "cmdz5,radio-emul"

include: base.yaml
```

## sw/dts/bindings/cmdz5,sx1262.yaml
```yaml
description: |
  Semtech SX1262 as the mesh radio (raw LoRa packets with a free sync word,
  see include/cmdz5/drivers/mesh_radio.h). Zephyr's own semtech,sx1262
  driver cannot set the Meshtastic sync word 0x2b. Property names follow
  Zephyr's semtech,sx126x binding.

compatible: "cmdz5,sx1262"

include: spi-device.yaml

properties:
  reset-gpios:
    type: phandle-array
    required: true
    description: NRESET (active low).

  busy-gpios:
    type: phandle-array
    required: true
    description: BUSY (active high).

  dio1-gpios:
    type: phandle-array
    required: true
    description: DIO1, the interrupt line (active high).

  rx-enable-gpios:
    type: phandle-array
    description: |
      RF switch receive path, high while receiving and low otherwise.

  dio2-tx-enable:
    type: boolean
    description: DIO2 drives the RF switch transmit path.

  dio3-tcxo-voltage:
    type: int
    description: |
      TCXO supply on DIO3, one of SX126X_DIO3_TCXO_* from
      <zephyr/dt-bindings/lora/sx126x.h>. Without it, a crystal is assumed.

  tcxo-power-startup-delay-ms:
    type: int
    default: 5
    description: TCXO start-up time.

  power-supply:
    type: phandle
    description: Regulator that powers the radio, switched on while it is in use.
```

## sw/dts/bindings/sony,cmdz5-lcd.yaml
```yaml
description: |
  Display controller of the Sony CMD-Z5 (96 x 72 pixels, 2 bpp, write-only).
  The node is a child of an lcd bus node (cmdz5,lcd-bus-gpio or
  cmdz5,lcd-bus-emul).

compatible: "sony,cmdz5-lcd"

include: base.yaml

properties:
  power-supply:
    type: phandle
    description: Regulator for the display supply, switched off with the display.

  contrast:
    type: int
    default: 0x85
    description: Initial value of registers 0x23/0x24 (probably the contrast).
```

## sw/emul/Kconfig
```kconfig
# Emulator front panel for native_sim

config CMDZ5_EMUL
	bool "CMD-Z5 emulator"
	default y
	depends on DT_HAS_CMDZ5_FRONTPANEL_ENABLED
	select HAS_SDL
	select INPUT
	select LED
	help
	  SDL2 front panel with display, keys, wheel, LEDs, vibration and
	  audio, plus emulated drivers behind the same APIs as the board.

module = CMDZ5_EMUL
module-str = CMD-Z5 emulator
source "subsys/logging/Kconfig.template.log_config"
```
